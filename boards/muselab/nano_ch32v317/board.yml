## boards/muselab/nano_ch32v317/board.yml
```yaml
board:
  name: nano_ch32v317
  full_name: MuseLab nanoCH32V317
  vendor: muselab
  socs:
    - name: ch32v317
```

## samples/west.yml
```yaml
manifest:
  version: 0.8

  projects:
    - name: zephyr
      # revision: v4.3.0
      # url: https://github.com/zephyrproject-rtos/zephyr
      url: https://github.com/BOJIT/zephyr
      # revision: main
      revision: driver/ch32v30x_ethernet

      import:
        file: west.yml
        path-prefix: deps
        name-allowlist:
          - cmsis_6
          - hal_wch

  self:
    path: samples
```
