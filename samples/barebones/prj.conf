## CMakeLists.txt
```
cmake_minimum_required(VERSION 3.20.0)
find_package(Zephyr REQUIRED HINTS $ENV{ZEPHYR_BASE})

project(barebones)
target_sources(app PRIVATE
    src/main.c
)
```

## prj.conf
```kconfig
# Core
CONFIG_MAIN_STACK_SIZE=512

# Logs
```

## src/main.c
```c
/**
 * @file main.c
 * @author James Bennion-Pedley
 * @brief Main entry point for application
 * @date 01/06/2025
 *
 * @copyright Copyright (c) 2025
 *
 */

/*--------------------------------- Includes ---------------------------------*/

#include <zephyr/device.h>
#include <zephyr/kernel.h>
#include <zephyr/sys/clock.h>

/*---------------------------- Macros & Constants ----------------------------*/

/*----------------------------------- State ----------------------------------*/

/*------------------------------ Private Functions ---------------------------*/

/*------------------------------- Public Functions ---------------------------*/

/*-------------------------------- Entry Point -------------------------------*/

int main(void)
{
	int64_t target_ms = ((k_uptime_get() + MSEC_PER_SEC) / MSEC_PER_SEC) * MSEC_PER_SEC;
	while (1) {
		target_ms += MSEC_PER_SEC;
		k_sleep(K_TIMEOUT_ABS_MS(target_ms));
	}
}
```
