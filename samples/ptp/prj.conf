## CMakeLists.txt
```
cmake_minimum_required(VERSION 3.20.0)
find_package(Zephyr REQUIRED HINTS $ENV{ZEPHYR_BASE})

project(ptp)
target_sources(app PRIVATE
    src/main.c
)
```

## prj.conf
```kconfig
# Core
CONFIG_MAIN_STACK_SIZE=2048

# Peripherals
CONFIG_GPIO=y

# Logs
CONFIG_LOG=y
CONFIG_NET_LOG=y

# Shell
CONFIG_SHELL=y
CONFIG_SHELL_BACKEND_SERIAL=y

# Networking
CONFIG_NETWORKING=y
CONFIG_NET_SHELL=y
CONFIG_NET_STATISTICS=y
CONFIG_NET_CONFIG_AUTO_INIT=y
CONFIG_NET_UDP=y
CONFIG_NET_TCP=y
CONFIG_NET_IPV6=n
CONFIG_NET_IPV4=y
CONFIG_NET_DHCPV4=y
CONFIG_NET_SOCKETS=y
CONFIG_POSIX_API=y
CONFIG_NET_CONFIG_SETTINGS=y
CONFIG_NET_CONFIG_NEED_IPV4=y

CONFIG_NET_IF_MAX_IPV4_COUNT=5
CONFIG_NET_IF_MCAST_IPV4_ADDR_COUNT=5
CONFIG_NET_MAX_CONN=8
CONFIG_ZVFS_POLL_MAX=9

CONFIG_NET_PKT_RX_COUNT=20
CONFIG_NET_PKT_TX_COUNT=10
CONFIG_NET_BUF_RX_COUNT=20
CONFIG_NET_BUF_TX_COUNT=20
CONFIG_NET_MAX_CONTEXTS=10

CONFIG_NET_HOSTNAME_ENABLE=y
CONFIG_NET_HOSTNAME_UNIQUE=y
CONFIG_NET_HOSTNAME="wch-integration"

CONFIG_PTP=y
CONFIG_PTP_CLOCK_SHELL=y

CONFIG_TEST_RANDOM_GENERATOR=y # Required for CI only
```

## src/main.c
```c
/**
 * @file main.c
 * @author James Bennion-Pedley
 * @brief Main entry point for application
 * @date 01/06/2025
 *
 * @copyright Copyright (c) 2025
 *
 */

/*--------------------------------- Includes ---------------------------------*/

#include <zephyr/device.h>
#include <zephyr/kernel.h>
#include <zephyr/sys/clock.h>
#include <zephyr/net/hostname.h>

#include <zephyr/logging/log.h>

/*---------------------------- Macros & Constants ----------------------------*/

LOG_MODULE_REGISTER(main, CONFIG_LOG_DEFAULT_LEVEL);

/*----------------------------------- State ----------------------------------*/

/*------------------------------ Private Functions ---------------------------*/

/*------------------------------- Public Functions ---------------------------*/

/*-------------------------------- Entry Point -------------------------------*/

int main(void)
{
	LOG_INF("Device Hostname: %s", net_hostname_get());

	int64_t target_ms = ((k_uptime_get() + MSEC_PER_SEC) / MSEC_PER_SEC) * MSEC_PER_SEC;
	while (1) {
		target_ms += MSEC_PER_SEC;
		k_sleep(K_TIMEOUT_ABS_MS(target_ms));
	}
}
```
